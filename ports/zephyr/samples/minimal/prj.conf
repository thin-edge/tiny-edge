## CMakeLists.txt
```
# SPDX-License-Identifier: Apache-2.0
#
# Smallest application that uses tiny-edge on Zephyr. It builds with Zephyr and this
# module only, which proves the module does not depend on the repository that
# hosts it.
cmake_minimum_required(VERSION 3.20.0)

# The module is the repository root, four levels up. In a workspace where
# tiny-edge is a west project west finds it anyway; adding it twice is harmless.
list(APPEND ZEPHYR_EXTRA_MODULES ${CMAKE_CURRENT_SOURCE_DIR}/../../../..)

find_package(Zephyr REQUIRED HINTS $ENV{ZEPHYR_BASE})
project(tedge_minimal C)

target_sources(app PRIVATE src/main.c)
```

## sample.yaml
```
# SPDX-License-Identifier: Apache-2.0
#
# Every client profile on every board the sample supports, so CI compiles
# each feature the profiles enable:
#
#   west twister -T ports/zephyr/samples --integration
#
# native_sim builds and runs (the console must show the version). It has no
# MCUboot and no shell, so the firmware update, coredump and shell features
# drop out there. The ESP32 builds carry every feature, with MCUboot, and add
# the board's sizing after the profile, as an application would: the
# ESP32-C6 (RISC-V, no PSRAM) and the ESP32-S3-DevKitC (Xtensa, TLS heap in
# PSRAM).
sample:
  name: tiny-edge minimal
  description: Smallest application that includes the tiny-edge client
common:
  tags: tedge
  harness: console
  harness_config:
    type: one_line
    regex:
      - "tedge-zephyr [0-9]+\\.[0-9]+\\.[0-9]+"
tests:
  sample.tedge.minimal.host.minimal:
    platform_allow: native_sim/native/64
    integration_platforms: [native_sim/native/64]
    extra_conf_files: [prj.conf, ../../profiles/minimal.conf]
  sample.tedge.minimal.host.full:
    platform_allow: native_sim/native/64
    integration_platforms: [native_sim/native/64]
    extra_conf_files: [prj.conf, ../../profiles/full.conf]
  sample.tedge.minimal.esp32c6.minimal:
    build_only: true
    platform_allow: esp32c6_devkitc/esp32c6/hpcore
    integration_platforms: [esp32c6_devkitc/esp32c6/hpcore]
    extra_conf_files:
      - prj.conf
      - ../../profiles/minimal.conf
      - ../../profiles/boards/esp32c6-devkitc.conf
  sample.tedge.minimal.esp32c6.ota:
    build_only: true
    sysbuild: true
    platform_allow: esp32c6_devkitc/esp32c6/hpcore
    integration_platforms: [esp32c6_devkitc/esp32c6/hpcore]
    extra_args: [SB_CONFIG_BOOTLOADER_MCUBOOT=y]
    extra_conf_files:
      - prj.conf
      - ../../profiles/ota.conf
      - ../../profiles/boards/esp32c6-devkitc.conf
  sample.tedge.minimal.esp32c6.full:
    build_only: true
    sysbuild: true
    platform_allow: esp32c6_devkitc/esp32c6/hpcore
    integration_platforms: [esp32c6_devkitc/esp32c6/hpcore]
    extra_args: [SB_CONFIG_BOOTLOADER_MCUBOOT=y]
    extra_conf_files:
      - prj.conf
      - ../../profiles/full.conf
      - ../../profiles/boards/esp32c6-devkitc.conf
  sample.tedge.minimal.esp32s3.minimal:
    build_only: true
    platform_allow: esp32s3_devkitc/esp32s3/procpu
    integration_platforms: [esp32s3_devkitc/esp32s3/procpu]
    extra_conf_files:
      - prj.conf
      - ../../profiles/minimal.conf
      - ../../profiles/boards/esp32s3-devkitc.conf
  sample.tedge.minimal.esp32s3.ota:
    build_only: true
    sysbuild: true
    platform_allow: esp32s3_devkitc/esp32s3/procpu
    integration_platforms: [esp32s3_devkitc/esp32s3/procpu]
    extra_args: [SB_CONFIG_BOOTLOADER_MCUBOOT=y]
    extra_conf_files:
      - prj.conf
      - ../../profiles/ota.conf
      - ../../profiles/boards/esp32s3-devkitc.conf
  sample.tedge.minimal.esp32s3.full:
    build_only: true
    sysbuild: true
    platform_allow: esp32s3_devkitc/esp32s3/procpu
    integration_platforms: [esp32s3_devkitc/esp32s3/procpu]
    extra_args: [SB_CONFIG_BOOTLOADER_MCUBOOT=y]
    extra_conf_files:
      - prj.conf
      - ../../profiles/full.conf
      - ../../profiles/boards/esp32s3-devkitc.conf
  sample.tedge.minimal.esp32s3.onboarding:
    build_only: true
    platform_allow: esp32s3_devkitc/esp32s3/procpu
    integration_platforms: [esp32s3_devkitc/esp32s3/procpu]
    extra_conf_files:
      - prj.conf
      - ../../profiles/minimal.conf
      - ../../profiles/boards/esp32s3-devkitc.conf
      - overlay-onboarding.conf
  sample.tedge.minimal.esp32c6.onboarding:
    build_only: true
    platform_allow: esp32c6_devkitc/esp32c6/hpcore
    integration_platforms: [esp32c6_devkitc/esp32c6/hpcore]
    extra_conf_files:
      - prj.conf
      - ../../profiles/minimal.conf
      - ../../profiles/boards/esp32c6-devkitc.conf
      - overlay-onboarding.conf
```

## prj.conf
```kconfig
# SPDX-License-Identifier: Apache-2.0
#
# The smallest application that hosts the client. Build it with one of the
# client's profiles, which picks the features and sets the mbedTLS options
# the Cumulocity transport needs:
#
#   west build -b <board> ports/zephyr/samples/minimal -- \
#     -DEXTRA_CONF_FILE=$PWD/ports/zephyr/profiles/minimal.conf
#
# boards/<board>.conf adds the board's network and settings storage;
# sample.yaml lists every profile and board CI builds.

CONFIG_TEDGE=y
CONFIG_LOG=y
```

## overlay-c8y.conf
```kconfig
# SPDX-License-Identifier: Apache-2.0
#
# What an application must provide for the client's Cumulocity transport.
# The client selects the protocol pieces (MQTT, sockets, TLS sockets,
# credentials, SNTP) itself; these are the application's to size.

# --- TLS: the client's requirements, from ports/zephyr/README.md ---
CONFIG_MBEDTLS=y
CONFIG_MBEDTLS_ENABLE_HEAP=y
CONFIG_MBEDTLS_HEAP_SIZE=57344
CONFIG_MBEDTLS_SSL_MAX_CONTENT_LEN=16384
CONFIG_MBEDTLS_SSL_PROTO_TLS1_2=y
CONFIG_MBEDTLS_CIPHERSUITE_TLS_ECDHE_RSA_WITH_AES_128_GCM_SHA256=y
CONFIG_MBEDTLS_CIPHERSUITE_TLS_ECDHE_ECDSA_WITH_AES_128_GCM_SHA256=y
CONFIG_PSA_WANT_ECC_SECP_R1_256=y
CONFIG_MBEDTLS_SSL_SERVER_NAME_INDICATION=y
CONFIG_MBEDTLS_HAVE_TIME_DATE=y
CONFIG_MBEDTLS_PEM_PARSE_C=y
CONFIG_MBEDTLS_X509_CRT_PARSE_C=y

# --- Wi-Fi: the application owns the network ---
CONFIG_WIFI=y
CONFIG_WIFI_ESP32=y
CONFIG_NET_L2_ETHERNET=y
CONFIG_NET_DHCPV4=y
CONFIG_NET_CONNECTION_MANAGER=y
CONFIG_TEDGE_SAMPLE_WIFI_SSID=""
CONFIG_TEDGE_SAMPLE_WIFI_PSK=""

# --- Settings: the client stores its identity and credentials here ---
CONFIG_FLASH=y
CONFIG_FLASH_MAP=y
CONFIG_NVS=y
CONFIG_SETTINGS_NVS=y
# The device key lives in PSA ITS, stored through settings.
CONFIG_SECURE_STORAGE_ITS_STORE_IMPLEMENTATION_SETTINGS=y

# --- Sockets and connections the client needs (README) ---
CONFIG_NET_MAX_CONN=6
CONFIG_NET_MAX_CONTEXTS=8
CONFIG_ZVFS_OPEN_MAX=8
```

## overlay-onboarding.conf
```kconfig
# SPDX-License-Identifier: Apache-2.0
#
# Set the device up with a tool over the console (tedge-onboard): the
# provisioning library speaks Improv Serial after "tedge improv", the
# sample joins and stores the Wi-Fi network it is given, and the client
# enrolls with the tenant and one-time password it is given. Nothing
# about the network or the tenant is built in.
#
#   west build -b esp32s3_devkitc/esp32s3/procpu ports/zephyr/samples/minimal -- \
#     -DEXTRA_CONF_FILE="$PWD/ports/zephyr/profiles/minimal.conf;\
#   $PWD/ports/zephyr/profiles/boards/esp32s3-devkitc.conf;\
#   $PWD/ports/zephyr/samples/minimal/overlay-onboarding.conf"

CONFIG_TEDGE_PROVISIONING=y

CONFIG_SHELL=y
CONFIG_WIFI_CREDENTIALS=y
CONFIG_WIFI_CREDENTIALS_BACKEND_SETTINGS=y
CONFIG_WIFI_CREDENTIALS_CONNECT_STORED=y
```

## boards/esp32c6_devkitc_esp32c6_hpcore.conf
```kconfig
# SPDX-License-Identifier: Apache-2.0
#
# ESP32-C6-DevKitC: Wi-Fi station with DHCP, and settings in NVS (the device
# key and certificate live there). The client's sizing for this board (TLS
# heap, connection counts) is ports/zephyr/profiles/boards/esp32c6-devkitc.conf,
# which sample.yaml adds after the profile.
CONFIG_WIFI=y
CONFIG_WIFI_ESP32=y
CONFIG_NET_L2_ETHERNET=y
CONFIG_NET_DHCPV4=y
CONFIG_NET_CONNECTION_MANAGER=y

CONFIG_FLASH=y
CONFIG_FLASH_MAP=y
CONFIG_NVS=y
CONFIG_SETTINGS_NVS=y
```

## boards/esp32s3_devkitc_esp32s3_procpu.conf
```kconfig
# SPDX-License-Identifier: Apache-2.0
#
# ESP32-S3-DevKitC-1 (N16R8): Wi-Fi station with DHCP, and settings in NVS
# (the device key and certificate live there). The client's sizing for this
# board (TLS heap in PSRAM, connection counts) is
# ports/zephyr/profiles/boards/esp32s3-devkitc.conf, which sample.yaml adds
# after the profile.
CONFIG_WIFI=y
CONFIG_WIFI_ESP32=y
CONFIG_NET_L2_ETHERNET=y
CONFIG_NET_DHCPV4=y
CONFIG_NET_CONNECTION_MANAGER=y

CONFIG_FLASH=y
CONFIG_FLASH_MAP=y
CONFIG_NVS=y
CONFIG_SETTINGS_NVS=y
```

## boards/native_sim_native_64.conf
```kconfig
# SPDX-License-Identifier: Apache-2.0
#
# native_sim: the host's network through offloaded sockets, and settings on
# the simulated flash (the device key and certificate live there).
CONFIG_NET_DRIVERS=y
CONFIG_NET_NATIVE_OFFLOADED_SOCKETS=y

CONFIG_FLASH=y
CONFIG_FLASH_MAP=y
CONFIG_NVS=y
CONFIG_SETTINGS_NVS=y
```

## src/main.c
```c
/* SPDX-License-Identifier: Apache-2.0
 *
 * The smallest application that hosts the thin-edge.io client: join a Wi-Fi
 * network, then start the client and let it do the rest. Everything here is
 * the *application's* job; the client only reacts to the network being up.
 */

#include <zephyr/kernel.h>
#include <zephyr/logging/log.h>
#include <zephyr/net/net_if.h>
#include <zephyr/net/wifi_mgmt.h>

#include <tedge/tedge.h>

#include <string.h>

#if defined(CONFIG_TEDGE_PROVISIONING)
/* Setting the device up with a tool (tedge-onboard) over the console: the
 * port's hooks join and store the network it is given, so the next boot
 * joins it by itself. */
#include <tedge/provisioning_zephyr.h>
#include <zephyr/net/wifi_credentials.h>
#endif

LOG_MODULE_REGISTER(tedge_minimal, LOG_LEVEL_INF);

static void on_state(enum tedge_state state, void *user_data)
{
	ARG_UNUSED(user_data);

	if (state == TEDGE_STATE_AWAITING_REGISTRATION) {
		char url[220];

		/* The URL carries a one-time password: show it to the operator
		 * (here the console; a real device might use a display or its
		 * provisioner). */
		if (tedge_registration_url(url, sizeof(url)) > 0) {
			LOG_INF("register this device: %s", url);
		}
	}
}

static const struct tedge_hooks hooks = {
	.on_state = on_state,
};

#if defined(CONFIG_WIFI)
static int wifi_connect(void)
{
	struct net_if *iface = net_if_get_first_wifi();
	struct wifi_connect_req_params p = {
		.ssid = (const uint8_t *)CONFIG_TEDGE_SAMPLE_WIFI_SSID,
		.ssid_length = strlen(CONFIG_TEDGE_SAMPLE_WIFI_SSID),
		.psk = (const uint8_t *)CONFIG_TEDGE_SAMPLE_WIFI_PSK,
		.psk_length = strlen(CONFIG_TEDGE_SAMPLE_WIFI_PSK),
		.security = strlen(CONFIG_TEDGE_SAMPLE_WIFI_PSK)
				    ? WIFI_SECURITY_TYPE_PSK
				    : WIFI_SECURITY_TYPE_NONE,
		.channel = WIFI_CHANNEL_ANY,
		.band = WIFI_FREQ_BAND_2_4_GHZ,
	};

	if (iface == NULL) {
		LOG_ERR("no Wi-Fi interface");
		return -ENODEV;
	}
	LOG_INF("joining \"%s\"", CONFIG_TEDGE_SAMPLE_WIFI_SSID);
	return net_mgmt(NET_REQUEST_WIFI_CONNECT, iface, &p, sizeof(p));
}
#endif

int main(void)
{
	LOG_INF("tedge-zephyr %s", tedge_version());

#if defined(CONFIG_TEDGE_PROVISIONING)
	if (!wifi_credentials_is_empty()) {
		/* Set up before: join the network it was given. */
		(void)net_mgmt(NET_REQUEST_WIFI_CONNECT_STORED,
			       net_if_get_first_wifi(), NULL, 0);
	} else if (strlen(CONFIG_TEDGE_SAMPLE_WIFI_SSID) > 0) {
		(void)wifi_connect();
	} else {
		LOG_INF("no Wi-Fi network yet: set the device up with "
			"tedge-onboard");
	}
#elif defined(CONFIG_WIFI)
	/* The client waits for an address by itself, so a failure here only
	 * delays it: the application can retry however it likes. */
	(void)wifi_connect();
#endif

	if (tedge_init(NULL, &hooks) == 0) {
#if defined(CONFIG_TEDGE_PROVISIONING)
		(void)tedge_provisioning_zephyr_init(NULL);
#endif
		(void)tedge_start();
	}
	return 0;
}
```
