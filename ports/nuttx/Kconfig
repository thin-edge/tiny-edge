## ports/nuttx/Kconfig
```kconfig
#
# SPDX-License-Identifier: Apache-2.0
#
# tiny-edge on NuttX. The option names are the core's (TEDGE_*), so
# tools/generate.cmake maps CONFIG_TEDGE_X to TEDGE_X in <tedge_config.h>
# without a list to keep up to date. The defaults are the POSIX port's,
# since this port builds on it, except where a microcontroller needs less.
#

menuconfig TINY_EDGE
	bool "tiny-edge (thin-edge.io client)"
	default n
	depends on NET_TCP && NET_IPv4 && NETDB_DNSCLIENT
	select NET_SOCKOPTS
	select LIBC_NETDB
	---help---
		The thin-edge.io client for Cumulocity, with the sample
		device agent (samples/agent) as the program "tiny_edge".

if TINY_EDGE

config TINY_EDGE_PROGNAME
	string "Program name"
	default "tiny_edge"

config TINY_EDGE_PRIORITY
	int "Priority of the program's main task"
	default 100

config TINY_EDGE_STACKSIZE
	int "Stack of the program's main task"
	default 8192

config TINY_EDGE_STATE_DIR
	string "Where the client keeps its settings and the device key"
	default "/data/tedge"
	---help---
		A directory on a writable file system that survives a
		restart, such as LittleFS on a flash partition.

config TINY_EDGE_INTERFACE
	string "Network interface"
	default "wlan0"

config TINY_EDGE_WIFI_FILE
	string "File with the Wi-Fi network to join"
	default "/data/wifi.conf"
	---help---
		Two lines, the network's name and its password. Written by
		set-up over USB (tedge-onboard), or by hand for a test.

config TINY_EDGE_FIRMWARE_NAME
	string "Firmware name the agent reports"
	default "tiny-edge-nuttx-agent"
	---help---
		The name in c8y_Firmware and the name an update must carry.

config TINY_EDGE_FIRMWARE_VERSION
	string "Firmware version the agent reports"
	default ""
	---help---
		The version in c8y_Firmware. Empty: tiny-edge's own version.
		scripts/build.sh --version sets it, and signs the same
		MAJOR.MINOR.PATCH into the MCUboot header.

config TINY_EDGE_MEASUREMENT_INTERVAL_S
	int "Seconds between the device's own measurements"
	default 60

config TINY_EDGE_MBEDTLS_DIR
	string "mbedTLS 4 source directory"
	default ""
	---help---
		An unpacked mbedTLS 4.1 release. Empty: the build downloads
		mbedtls-4.1.0 and checks its SHA-256.

menu "Cumulocity"

config TEDGE_TRANSPORT_C8Y
	bool
	default y

config TEDGE_C8Y_URL
	string "Tenant host (also set at run time)"
	default ""

config TEDGE_C8Y_CA_FILES
	string "Trust anchors (PEM files, relative to the repository)"
	default "certs/godaddy-root-g2.pem"

config TEDGE_DOWNLOAD_CA_FILES
	string "Roots for downloads outside the tenant only (PEM files)"
	default "certs/isrg-root-x1.pem certs/usertrust-ecc.pem"
	---help---
		Trusted, in addition to TEDGE_C8Y_CA_FILES, only for HTTPS
		downloads from hosts outside the tenant's domain, such as a
		firmware URL on GitHub and the host it redirects to. Empty:
		such downloads verify against the tenant's anchors only.

config TEDGE_C8Y_OPERATION_JSON
	bool "Receive operations with their id"
	default y

config TEDGE_C8Y_PAYLOAD_BYTES
	int "Largest message the client accepts"
	default 2048 if TEDGE_C8Y_OPERATION_JSON
	default 1024

config TEDGE_REQUIRED_INTERVAL_MIN
	int "Required interval reported to Cumulocity (minutes)"
	default 60

config TEDGE_RECONNECT_BACKOFF_MAX_S
	int "Longest wait between reconnect attempts (s)"
	default 300

config TEDGE_SNTP
	bool "Set the clock with SNTP when it is not already valid"
	default y
	---help---
		Certificates cannot be validated without the time. The ESP
		chips' clock starts at 1970 after power-up and can hold a value
		that is no date at all after a reset; the client then asks
		TEDGE_SNTP_SERVER before it connects. With this off, the
		application must set the clock first.

config TEDGE_SNTP_SERVER
	string "SNTP server"
	default "pool.ntp.org"
	depends on TEDGE_SNTP

choice
	prompt "How the device authenticates"
	default TEDGE_AUTH_C8Y_CA

config TEDGE_AUTH_C8Y_CA
	bool "Cumulocity CA (certificate enrollment)"

config TEDGE_AUTH_BOOTSTRAP
	bool "Bootstrap credentials"

endchoice

config TEDGE_ENROLL_POLL_S
	int "Seconds between enrollment attempts"
	default 10
	depends on TEDGE_AUTH_C8Y_CA

config TEDGE_BOOTSTRAP_USER
	string "Bootstrap user (tenant/username)"
	default ""
	depends on TEDGE_AUTH_BOOTSTRAP

config TEDGE_BOOTSTRAP_PASSWORD
	string "Bootstrap password"
	default ""
	depends on TEDGE_AUTH_BOOTSTRAP

choice
	prompt "Cumulocity MQTT endpoint"
	default TEDGE_C8Y_MQTT_SERVICE

config TEDGE_C8Y_MQTT_SERVICE
	bool "MQTT Service"
	depends on TEDGE_AUTH_C8Y_CA

config TEDGE_C8Y_CORE_MQTT
	bool "Core MQTT"

endchoice

config TEDGE_DEVICE_ID_PREFIX
	string "Default external ID prefix"
	default "tedge"

config TEDGE_DEVICE_TYPE
	string "Device type"
	default "thin-edge.io-nuttx"

endmenu

menu "Features"

config TEDGE_TELEMETRY
	bool "Telemetry (measurements, events, alarms)"
	default y

config TEDGE_TELEMETRY_BUFFER_BYTES
	int "Bytes held for telemetry that cannot be sent yet"
	default 2048
	depends on TEDGE_TELEMETRY

config TEDGE_HEALTH
	bool "Device health measurements"
	default y
	select TEDGE_TELEMETRY

config TEDGE_HEALTH_INTERVAL_S
	int "Seconds between health measurements"
	default 900
	depends on TEDGE_HEALTH

config TEDGE_RESTART
	bool "Restart operation"
	default y

config TEDGE_FIRMWARE_UPDATE
	bool "Firmware update (MCUboot, with rollback)"
	default y
	depends on BOOT_MCUBOOT
	select TEDGE_HTTP
	---help---
		Writes the new image to MCUboot's secondary slot and boots it
		on trial: the image is kept only once it confirms itself, and
		MCUboot swaps the old one back otherwise. Needs nuttx-apps'
		MCUboot library (CONFIG_BOOT_MCUBOOT) and a board that boots
		through MCUboot, with slots large enough for the image (on the
		ESP chips, CONFIG_ESPRESSIF_BOOTLOADER_MCUBOOT; see
		configs/mcuboot.conf).

if TEDGE_FIRMWARE_UPDATE

config TEDGE_FIRMWARE_STACK_SIZE
	int "Stack of the download thread (bytes)"
	default 12288
	---help---
		A TLS handshake runs on this thread: the ESP-IDF port's size,
		with the same mbedTLS on the same chips.

config TEDGE_FIRMWARE_CONFIRM_AFTER_CONNECT
	bool "Confirm a test-booted image once it reaches the cloud"
	default y

config TEDGE_FIRMWARE_CONFIRM_TIMEOUT_S
	int "Seconds a test-booted image has to confirm itself"
	default 900
	range 0 86400

config TEDGE_FIRMWARE_PROGRESS
	bool "Publish download progress on a free-form topic"
	default y
	depends on TEDGE_C8Y_MQTT_SERVICE

config TEDGE_FIRMWARE_PROGRESS_PERCENT
	int "Percentage step between progress messages"
	default 10
	range 1 50
	depends on TEDGE_FIRMWARE_PROGRESS

endif # TEDGE_FIRMWARE_UPDATE

config TEDGE_SHELL_COMMAND
	bool "Shell command operation (c8y_Command)"
	default y
	depends on PIPES
	select SYSTEM_POPEN
	select SCHED_HAVE_PARENT
	select SCHED_CHILD_STATUS
	---help---
		Runs an allow-listed NSH command sent from the cloud, with
		popen(), and returns what it printed. Nothing runs until
		TEDGE_SHELL_COMMAND_ALLOW_LIST says what may. NuttX keeps a
		finished command's status only with SCHED_CHILD_STATUS, which
		this selects; its pclose() reports success or failure, not the
		command's exit code.

if TEDGE_SHELL_COMMAND

config TEDGE_SHELL_COMMAND_ALLOW_LIST
	string "Commands the cloud may run (comma-separated prefixes)"
	default ""
	---help---
		For example "free,uname,ps". A request must begin with one of
		these and may add arguments; anything that could chain a second
		command is refused whatever this says.

		Empty, the default, refuses every command: compiling the
		feature in is not the same as consenting to run something.

config TEDGE_SHELL_COMMAND_TIMEOUT_S
	int "Seconds before a command is reported as timed out"
	default 30
	range 1 600
	---help---
		popen() gives no process to stop, so the operation fails but
		the command keeps running until it returns. Keep commands that
		can block for ever off the allow-list.

config TEDGE_SHELL_COMMAND_OUTPUT_BYTES
	int "Output kept from a command (bytes)"
	default 512
	range 64 4096

config TEDGE_SHELL_COMMAND_STACK_SIZE
	int "Stack of the thread that runs a command (bytes)"
	default 4096
	---help---
		The thread starts the command with popen() and reads its
		output; the command itself runs as a task of its own.

endif # TEDGE_SHELL_COMMAND

config TEDGE_LOG_UPLOAD
	bool "Log upload"
	default y

config TEDGE_LOG_RING_BYTES
	int "The client's own log kept in RAM"
	default 2048
	depends on TEDGE_LOG_UPLOAD

config TEDGE_LOG_TYPE_SLOTS
	int "Log types the client can hold"
	default 4
	depends on TEDGE_LOG_UPLOAD

config TEDGE_LOG_UPLOAD_MAX_BYTES
	int "Most bytes one request may send"
	default 8192
	depends on TEDGE_LOG_UPLOAD

config TEDGE_LOG_UPLOAD_STACK_SIZE
	int "Stack of the upload thread"
	default 12288
	depends on TEDGE_LOG_UPLOAD

config TEDGE_CONFIG_MGMT
	bool "Configuration management"
	default y
	---help---
		Answers Cumulocity's configuration operations
		(c8y_UploadConfigFile, c8y_DownloadConfigFile) for the
		configuration types below. A set downloads the file, which
		needs a second TLS session beside the MQTT one, as firmware
		update does.

config TEDGE_CONFIG_MGMT_STACK_SIZE
	int "Stack of the configuration thread"
	default 12288
	depends on TEDGE_CONFIG_MGMT

config TEDGE_CONFIG_MAX_BYTES
	int "Largest configuration file the device downloads"
	default 16384
	depends on TEDGE_CONFIG_MGMT

config TEDGE_TRUSTED_ROOTS
	bool "The trusted-roots configuration"
	default y
	depends on TEDGE_CONFIG_MGMT
	---help---
		Root certificates an operator adds from Cumulocity, trusted
		only for downloads from hosts outside the tenant, in addition
		to TEDGE_C8Y_CA_FILES and TEDGE_DOWNLOAD_CA_FILES. They never
		verify the tenant, and the compiled-in roots cannot be
		removed.

config TEDGE_TRUSTED_ROOTS_MAX
	int "Most stored roots"
	default 4
	depends on TEDGE_TRUSTED_ROOTS

config TEDGE_TRUSTED_ROOTS_MAX_DER
	int "Largest stored root (DER bytes)"
	default 1536
	depends on TEDGE_TRUSTED_ROOTS

config TEDGE_PARAMETERS
	bool "Parameters"
	default y

config TEDGE_PARAMETERS_MAX
	int "Maximum declared parameters, across all sets"
	default 16
	depends on TEDGE_PARAMETERS

config TEDGE_PARAMETERS_SELF
	bool "Offer the client's own tunables as a parameter set"
	default y
	depends on TEDGE_PARAMETERS

config TEDGE_CERT_RENEWAL
	bool "Certificate renewal"
	default y
	depends on TEDGE_AUTH_C8Y_CA

config TEDGE_CERT_RENEW_BEFORE_DAYS
	int "Renew when this many days of lifetime are left"
	default 30
	depends on TEDGE_CERT_RENEWAL

config TEDGE_CERT_RENEW_ALARM_DAYS
	int "Raise an alarm when this many days are left and renewal failed"
	default 7
	depends on TEDGE_CERT_RENEWAL

config TEDGE_CERT_RENEW_CHECK_HOURS
	int "Hours between certificate checks"
	default 24
	depends on TEDGE_CERT_RENEWAL

config TEDGE_REMOTE_ACCESS
	bool "Remote access"
	default y
	depends on TEDGE_AUTH_C8Y_CA

if TEDGE_REMOTE_ACCESS

choice
	prompt "Which hosts a tunnel may reach"
	default TEDGE_REMOTE_ACCESS_TARGETS_LAN

config TEDGE_REMOTE_ACCESS_TARGETS_LAN
	bool "The device and its LAN"

config TEDGE_REMOTE_ACCESS_TARGETS_LIST
	bool "Only the allow-list"

config TEDGE_REMOTE_ACCESS_TARGETS_LOCAL
	bool "Only the device itself"

endchoice

config TEDGE_REMOTE_ACCESS_ALLOW_LIST
	string "Allow-list of host:port targets"
	default ""

config TEDGE_REMOTE_ACCESS_MAX_SESSIONS
	int "Maximum concurrent sessions"
	default 1

config TEDGE_REMOTE_ACCESS_BUF_SIZE
	int "Bridge buffer size per direction (bytes)"
	default 2048

config TEDGE_REMOTE_ACCESS_STACK_SIZE
	int "Stack of each session's bridge thread"
	default 12288

config TEDGE_REMOTE_ACCESS_IDLE_TIMEOUT_S
	int "Close a session after this many idle seconds (0: never)"
	default 900

config TEDGE_REMOTE_ACCESS_TWIN_SESSIONS
	bool "List the open sessions' targets in the twin data"
	default y

config TEDGE_REMOTE_ACCESS_MDNS
	bool "Resolve .local targets over mDNS"
	default y
	# The query goes to 224.0.0.251. Without NET_IGMP, NuttX's arp_out()
	# has no multicast MAC mapping, treats the group as off-link and sends
	# the frame to the default gateway, so no responder on the LAN sees it.
	select NET_IGMP
	---help---
	  A remote-access target named "<host>.local" is resolved by a
	  one-shot mDNS query that the client sends itself. Selects NET_IGMP,
	  which NuttX needs to send to a multicast group on the link. Without
	  this option a ".local" target fails with "mDNS is not built in".

config TEDGE_REMOTE_ACCESS_RESOLVE_TIMEOUT_MS
	int "How long each lookup of a target name waits (ms)"
	default 5000

config TEDGE_REMOTE_ACCESS_RESOLVE_ATTEMPTS
	int "Lookups of a target name before the session fails"
	default 3

config TEDGE_REMOTE_ACCESS_RESOLVE_RETRY_DELAY_MS
	int "Pause between lookups of a target name (ms)"
	default 500

endif # TEDGE_REMOTE_ACCESS

config TEDGE_HTTP_MAX_REDIRECTS
	int "HTTP redirects to follow"
	default 3

config TEDGE_PROVISIONING
	bool "Set-up over USB (Improv Serial, for tedge-onboard)"
	default n

config TEDGE_PROVISIONING_SERIAL
	bool
	default y
	depends on TEDGE_PROVISIONING

config TEDGE_PROVISIONING_STACK_SIZE
	int "Stack of the provisioning worker"
	default 4096
	depends on TEDGE_PROVISIONING

config TEDGE_HTTP
	bool
	default y if TEDGE_LOG_UPLOAD || TEDGE_FIRMWARE_UPDATE || TEDGE_CONFIG_MGMT

config TEDGE_HTTP_CLIENT
	bool
	default y if TEDGE_HTTP || TEDGE_AUTH_C8Y_CA || TEDGE_REMOTE_ACCESS

endmenu

menu "Resources"

config TEDGE_LOG_LEVEL
	int "Log level: 0 none, 1 error, 2 warning, 3 info, 4 debug"
	default 3

config TEDGE_HEAP_SIZE
	int "Bytes the client may allocate"
	default 20480 if TEDGE_TRUSTED_ROOTS
	default 16384

config TEDGE_THREAD_STACK_SIZE
	int "Stack of the client's main thread"
	---help---
		The ESP-IDF port's sizes, on the same chips with the same
		mbedTLS: a TLS handshake runs on this thread, and on the
		upload and remote access threads (12288).
	default 8192

config TEDGE_THREAD_PRIORITY
	int "Priority of the client's threads (0: the port's default)"
	default 0

endmenu

endif # TINY_EDGE
```
